//功能 ：用于测试定时器T4的文件
//定时器每50ms扫描一次按键，若连续N次检测到按下状态则认为一次有效，将按键状态保存到一个全局变量
//主程序通过全局变量的状态判断哪个按键按下了。
//作者网址：WWW.JIXIN.PRO
#include<T4_Key.h>
#define  N_ms  2   // (N_ms+1)*25 ms 处理一次


bit Key_1=0,Key_2=0,Key_3=0;//三个按键的状态，全局变量 1表示按下 ，每次用过之后需要手动置零
static unsigned char T4_Count=0;//T4中断计数器，只在这个文件里面使用
static bit Key1_1=0,Key2_1=0,Key3_1=0;//检测三个按键用的临时变量

//初始化定时器T4
void Init_T4(void)
{
	//初始化T4作为MCULED指示灯
	T4T3M &= 0xDF;//12T工作模式
	T4L = 0xDC;
	T4H = 0x0B;//初始化时间  30MHZ 25MS
	//T4T3M |= 0x10;//P0.6输出T4的溢出率
	IE2 |= 0X40;//允许T4中断
	T4T3M |= 0x80;//打开T4定时器
}
//定时器T4中断服务程序 25Ms中断一次
void T4_INT(void) interrupt 20
{
	T4_Count++;
	if(T4_Count > N_ms)// (N_ms+1)*25 ms 处理一次
	{
		T4_Count = 0;
		LED1 = ~LED1;//板载LED1闪烁
		if(Key1_1)//如果已经按下了一次了
		{
			if(KEY1)//如果第二次检测，松手了，放弃所有的状态
				;
			else //如果第二次检测有效，则传送有效状态到全局变量
				Key_1 = 1;
			Key1_1 = 0;
		}
		else//第一次检测到按键按下
		{
			Key1_1 = ~KEY1;//把按键状态送到临时变量里面
		}
		
		if(Key2_1)//如果已经按下了一次了
		{
			if(KEY2)//如果第二次检测，松手了，放弃所有的状态
				;
			else //如果第二次检测有效，则传送有效状态到全局变量
				Key_2 = 1;
			Key2_1 = 0;
		}
		else//第一次检测到按键按下
		{
			Key2_1 = ~KEY2;//把按键状态送到临时变量里面
		}
		
		if(Key3_1)//如果已经按下了一次了
		{
			if(KEY3)//如果第二次检测，松手了，放弃所有的状态
				;
			else //如果第二次检测有效，则传送有效状态到全局变量
				Key_3 = 1;
			Key3_1 = 0;
		}
		else//第一次检测到按键按下
		{
			Key3_1 = ~KEY3;//把按键状态送到临时变量里面
		}
		
	}
}



