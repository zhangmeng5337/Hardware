

#include "draw.h"
#include "sys.h"
//#include "lcd_string.h"

//ST7920内嵌了4个16×16的软件可编程的CGRAM
//能存储4个用户自定义字符的字模（16×16点阵），大小1K位。
//字符编码使用两个字节表示,分别为：0000h,0002h,0004h,0006h
//自定义字符写入CGRAM,不能断电保存
void LCD_Write_USR_CGRAM(void)
{
    //前三个user char的首地址0x40,0x50,0x60,0x70
    for (u8 j = 0; j < 4; j++)
    {
        LCD_WriteCMD(0x40 + j * 16);
        for (u8 i = 0; i < 16; i++)    //心形
        {
            LCD_WriteDATA(usr_char[i * 2 + j * 32]);
            LCD_WriteDATA(usr_char[i * 2 + 1 + j * 32]);
        }

    }

}



/********************************************************************
* 名称 : LCD_DISP_USR_Char
* 功能 : 在当前坐标位置显示单个字符
* 输入 : 显示的位置,cgram 中字符索引 index=1,2,3,4
* 说明: //在使用该函数前，确保已执行LCD_Write_USR_CGRAM()
//显示自定义的字符,并把这个字符填满16*16
***********************************************************************/

void LCD_DISP_USR_Char(u8 row, u8 col, u8 index)
{

    LCD_Set_XY(row, col);   //cgram char 映射输出的DDRAM地址
    LCD_WriteDATA(0x00);  //Must exist!
    LCD_WriteDATA((index - 1) *
                  2); // cgram :00,02,04,06  第index个字符存储地址偏移量

}


/*
From Datasheet:由扩充指令设置 GDRAM地址先垂直地址后水平地址（连续 2 个字节的数据
来定义垂直和水平地址），再2个字节的数据给绘图 RAM（先高 8位后低 8位）
*/
// 显示128*64点阵图像
// 从基本指令集切换到扩展指令集，一定要先清屏：LCD_Clear_GDRAM();否则会重叠显示
// 从扩展指令集切换到基本指令集，一定要先1.LCD_WriteCMD(0x30);  //绘图显示关，基本指令集
//2.delay_us(370); //delay is important!;否则字符不会显示出来
void LCD_Disp_Image(const u8 *str)
{
    u16 i, j;
    LCD_WriteCMD(0x30);      //8Bit扩充指令集,即使是36H也要写两次
    LCD_WriteCMD(
        0x36);  //绘图显示开，扩充指令集extended instruction(DL=8BITS,RE=1,G=1)
    delay_us(370);         //delay is important!

//*******显示上半屏内容
    for (i = 0; i < 32; i++)       //20H
    {
        LCD_WriteCMD(0x80 + i);   //SET  垂直地址 VERTICAL ADD
        LCD_WriteCMD(0x80);       //SET  水平地址 HORIZONTAL ADD
        for (j = 0; j < 16; j++)
        {
            LCD_WriteDATA(*str++);
        }
    }

//*******显示下半屏内容
    for (i = 0; i < 32; i++)
    {
        LCD_WriteCMD(0x80 + i); //SET 垂直地址 VERTICAL ADD
        LCD_WriteCMD(0x88);     //SET 水平地址 HORIZONTAL ADD
        for (j = 0; j < 16; j++)
        {
            LCD_WriteDATA(*str++);
        }
    }

}

//void PutBMP(unsigned char *puts)
//{
//     unsigned int x=0;
//     unsigned char i,j;
//     WriteCommand(0x34);      //8Bit扩充指令集,即使是36H也要写两次
//     WriteCommand(0x36);      //绘图ON,基本指令集里面36H不能开绘图
//     for(i=0;i<32;i++)            //12864实际为256x32
//     {
//           WriteCommand(0x80|i);      //行位置
//           WriteCommand(0x80);      //列位置
//           for(j=0;j<32;j++)      //256/8=32 byte
//           {            //列位置每行自动增加
//                 WriteData(puts[x]);
//                 x++;
//           }
//     }
//}
/***********************************************************
row:1-4
x_pos:0-7
y_pos:1-16
return:y addr,x addr
************************************************************/
unsigned int posXY;
unsigned int lcd_pos_extcmd(unsigned char row, unsigned char x_pos,
                            unsigned char y_pos)
{
    
    posXY = 0;
    switch (row)
    {
        case 1:
            posXY = 0x80; //y
            posXY = posXY + y_pos;
            posXY = posXY - 1;
            posXY = posXY << 8;
            posXY = posXY | 0x80; //x
            posXY = posXY + x_pos;//
            posXY = posXY - 1;
            break;
        case 2:
            posXY = posXY + 0x90; //y
            posXY = posXY + y_pos;
            posXY = posXY - 1;
            posXY = posXY << 8;
            posXY = posXY | 0x80; //x
            posXY = posXY + x_pos;//
            posXY = posXY - 1;

            break;
        case 3:
            posXY = posXY + 0x80; //y
            posXY = posXY + y_pos;
            posXY = posXY - 1;
            posXY = posXY << 8;
            posXY = posXY | 0x88; //x
            posXY = posXY + x_pos;//
            posXY = posXY - 1;

            break;
        case 4:
            posXY = posXY + 0x90; //y
            posXY = posXY + y_pos;
            posXY = posXY - 1;
            posXY = posXY << 8;
            posXY = posXY | 0x88; //x
            posXY = posXY + x_pos;//
            posXY = posXY - 1;

            break;


        default:
            posXY = 0x8080;
            break;

    }
    return posXY;
}


void LCD_Row_highlight(unsigned char row, unsigned char x_pos,
                       unsigned char y_pos,
                       unsigned char row_size, unsigned char col_size)
{
    unsigned char X = 0x80, Y = 0x80;
    unsigned char i, j;
    unsigned int result;

    result = lcd_pos_extcmd(row, x_pos, y_pos);
    Y = result >> 8;
    X = result;

    for (i = 0; i < row_size; i++)
    {
        for (j = 0; j < col_size; j++)
        {
            LCD_WriteCMD(0x34);
            LCD_WriteCMD(0x34);
            LCD_WriteCMD(Y);
            LCD_WriteCMD(X);
            LCD_WriteDATA(0xff);      //  low 8 bits
            LCD_WriteDATA(0xff);      //  low 8 bits

            Y++;
            j++;
        }

    }
}
unsigned char lcd_fresh_enable(unsigned char enbale)
{
    unsigned result;
    result = 0;
    if (enbale)
    {
        registerTick(LCD_BLINK_TICK, LCD_BLINK_TIME);

            if (GetTickResult(LCD_BLINK_TICK) == 1)
            {
                result = 1;
                reset_registerTick(LCD_BLINK_TICK);
                registerTick(LCD_BLINK_TICK, LCD_BLINK_TIME);
            }
    }
    return result;

}

void LCD12864_Fixpicture(unsigned char row, unsigned char x_pos,
                         unsigned char y_pos,
                         unsigned char row_size, unsigned char col_size, unsigned char *gImage)
{
    unsigned char X = 0x80, Y = 0x80;
    unsigned char i, j;
    unsigned int result;
	static unsigned char fresh_flag = 1;
	
//	if(lcd_fresh_enable(1)==1)
//	{
//		if(fresh_flag == 1)
//		fresh_flag = 0;	
//		else 
//			fresh_flag = 1;
//	}

		

    result = lcd_pos_extcmd(row, x_pos, y_pos);
    Y = result >> 8;
    X = result;
	if(fresh_flag==0x01)
	{
	    for (i = 0; i < row_size; i++)
	    {
	        for (j = 0; j < col_size; j++)
	        {
	            LCD_WriteCMD(0x34);
	            LCD_WriteCMD(Y);
	            LCD_WriteCMD(X);

	            LCD_WriteDATA(*(gImage + i * 16 + j)); //  low 8 bits
	            LCD_WriteDATA(*(gImage + i * 16 + j + 1)); //  high 8 bits
	            LCD_WriteCMD(0x36);
	            Y++;
	            j++;
	        }
	        ///result = lcd_pos_extcmd(row,x_pos,y_pos);
	        //X = result;

	    }
	    LCD_WriteCMD(0x30);

	}
	else
	{
    for (i = 0; i < row_size; i++)
    {
        for (j = 0; j < col_size; j++)
        {
            LCD_WriteCMD(0x34);
            LCD_WriteCMD(0x34);
            LCD_WriteCMD(Y);
            LCD_WriteCMD(X);
            LCD_WriteDATA(0xff);      //  low 8 bits
            LCD_WriteDATA(0xff);      //  low 8 bits
            Y++;
            j++;
        }

    }

	}
}
void LCD12864_picture(unsigned char *gImage)
{
    unsigned char X = 0x81, Y = 0x80;
    unsigned char i, j;
    unsigned int result;



    for (i = 0; i < 2; i++)
    {
        for (j = 0; j < 16; j++)
        {
            LCD_WriteCMD(0x34);
            LCD_WriteCMD(Y);
            LCD_WriteCMD(X);

            LCD_WriteDATA(*(gImage + i * 16 + j)); //  low 8 bits
            LCD_WriteDATA(*(gImage + i * 16 + j + 1)); //  high 8 bits
            LCD_WriteCMD(0x36);
            Y++;
            j++;
        }
//        X++;
//      X=0x88;
//        if(Y>0x9f)
//            Y=0x80;
//        X=0x80+((i+1)/32)*8;
//       X = 0x86;
    }
    LCD_WriteCMD(0x30);

}


void LCD_Baddot_test(void)
{
    u16 i, j;

    LCD_WriteCMD(
        0x36);  //绘图显示开，扩充指令集extended instruction(DL=8BITS,RE=1,G=1)
    delay_us(370);         //delay is important!

//*******显示上半屏内容
    for (i = 0; i < 32; i++)       //20H
    {
        LCD_WriteCMD(0x80 + i);   //SET  垂直地址 VERTICAL ADD
        LCD_WriteCMD(0x80);       //SET  水平地址 HORIZONTAL ADD
        for (j = 0; j < 16; j++)
        {
            LCD_WriteDATA(0xff);
            //HAL_Delay(50);
        }
    }

//*******显示下半屏内容
    for (i = 0; i < 32; i++)
    {
        LCD_WriteCMD(0x80 + i); //SET 垂直地址 VERTICAL ADD
        LCD_WriteCMD(0x88);     //SET 水平地址 HORIZONTAL ADD
        for (j = 0; j < 16; j++)
        {
            LCD_WriteDATA(0xff);
            //HAL_Delay(50);
        }
    }
}


// col+1, 水平移动16dot
void LCD_Disp_Large_Num2432(const u8 *Font, u8 col, u8 Num)
{
    u16 i, j;
    LCD_WriteCMD(
        0x36);  //绘图显示开，扩充指令集extended instruction(DL=8BITS,RE=1,G=1)
    delay_us(370);        //delay is important!

    for (i = 0; i < 32; i++)       //20H
    {
        LCD_WriteCMD(0x80 + i);   //SET  垂直地址 VERTICAL ADD //往下移动
        LCD_WriteCMD(0x80 + col);  //SET 水平地址 HORIZONTAL ADD,防止自动加1
        for (j = 0; j < 3; j++)
        {
            LCD_WriteDATA(*(Num * 96 + Font++));
        }
    }
}

// col+1, 水平移动16dot
void LCD_Disp_Large_Num1632(const u8 *Font, u8 col, u8 Num, bool reverse)
{
    u16 i, j;
    LCD_WriteCMD(
        0x36);  //绘图显示开，扩充指令集extended instruction(DL=8BITS,RE=1,G=1)
    delay_us(370);        //delay is important!

    for (i = 0; i < 32; i++)       //20H
    {
        LCD_WriteCMD(0x80 + i);   //SET  垂直地址 VERTICAL ADD //往下移动
        LCD_WriteCMD(0x80 + col);  //SET 水平地址 HORIZONTAL ADD,防止自动加1
        for (j = 0; j < 2; j++)
        {
            if (reverse)
                LCD_WriteDATA(~ * (Num * 64 + Font++));
            else
            {
                LCD_WriteDATA(*(Num * 64 + Font++));
            }
        }
    }
}


unsigned char const usr_char[] =

{

    /*-- user char :heart.bmp  --*/

    /*--  宽度x高度=16x16  --*/

    0x00, 0x00, 0x00, 0x00, 0x0C, 0xFC, 0x3F, 0xBE, 0x3F, 0x7E, 0x7F, 0xFF, 0x7F, 0xFF, 0x7F, 0xFF,
    0x7F, 0xFE, 0x3F, 0xFE, 0x1F, 0xFC, 0x0F, 0xF0, 0x07, 0xE0, 0x07, 0x80, 0x03, 0x00, 0x00, 0x00, // heart

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    0xFF, 0xF0, 0x07, 0xFF, 0xF8, 0x0F, 0x80, 0xF8, 0x0F, 0x00, 0x7C, 0x1E, 0x00, 0x3C, 0x1E, 0x00

};

//电池图标16*08
const unsigned char icon_Battery[] =
{
    0x18, 0x7E, 0x42, 0x42, 0x42, 0x42, 0x42, 0x42, 0x42, 0x42, 0x42, 0x42, 0x42, 0x42, 0x7E, 0x00, //电池放空
    0x18, 0x7E, 0x42, 0x42, 0x42, 0x42, 0x42, 0x42, 0x42, 0x42, 0x7E, 0x7E, 0x7E, 0x7E, 0x7E, 0x00, //剩余1/3
    0x18, 0x7E, 0x42, 0x42, 0x42, 0x42, 0x7E, 0x7E, 0x7E, 0x7E, 0x7E, 0x7E, 0x7E, 0x7E, 0x7E, 0x00, //剩余2/3
    0x18, 0x7E, 0x7E, 0x7E, 0x7E, 0x7E, 0x7E, 0x7E, 0x7E, 0x7E, 0x7E, 0x7E, 0x7E, 0x7E, 0x7E, 0x00, //电池满格
};


/**********PCTolCD2002 @ 阴码，顺向，逐行式************************************/
const unsigned char  Logo[] =
{
    //  Hellokitty
    0x00, 0x00, 0x00, 0x00, 0x00, 0x00, 0x00, 0x00, 0x07, 0xF8, 0x00, 0x7F, 0x00, 0x00, 0x00, 0x00,
    0x00, 0x00, 0x00, 0x02, 0x00, 0x00, 0x00, 0x00, 0x1F, 0xFC, 0x03, 0xFF, 0x80, 0x00, 0x00, 0x00,
    0x00, 0x00, 0x00, 0x1F, 0xF8, 0x00, 0x00, 0x00, 0x3F, 0xFE, 0x5F, 0xFF, 0xC0, 0x00, 0x00, 0x00,
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    0x00, 0x00, 0x00, 0x09, 0x00, 0x00, 0x7F, 0xFF, 0xFF, 0xFC, 0x00, 0x00, 0x00, 0x80, 0x00, 0x00,
    /*"C:\Users\casy\Desktop\KT.bmp",0*/
};

//const u8  digitalFont_16x32[10][64]
/*=====================显示模式3数字图片（宽度x高度=16*32）=========================*/
const u8  digitalFont_16x32[]
    = //阴码，顺向，逐行式 C51 十六进制，对应英文点阵 16×32
// 0(0) 1(1) 2(2) 3(3) 4(4) 5(5) 6(6) 7(7) 8(8) 9(9) 10(:) 11( )
{
    0x00, 0x00, 0x00, 0x00, 0x00, 0x00, 0x00, 0x00, 0x03, 0xE0, 0x0F, 0xF8, 0x1F, 0xFC, 0x1E, 0x3C,
    0x3C, 0x1E, 0x38, 0x0E, 0x38, 0x0E, 0x70, 0x07, 0x70, 0x07, 0x70, 0x07, 0x70, 0x07, 0x70, 0x07,
    0x70, 0x07, 0x70, 0x07, 0x70, 0x07, 0x70, 0x07, 0x38, 0x0E, 0x38, 0x0E, 0x3C, 0x1E, 0x1E, 0x3C,
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    0x00, 0x00, 0x00, 0x00, 0x00, 0x00, 0x00, 0x00, 0x00, 0x00, 0x00, 0x00, 0x00, 0x00, 0x00, 0x00, /*" ",11*/

};


/*=====================显示模式3数字图片（宽度x高度=24*32）=========================*/
const u8  digitalFont2_24x32[10][96] =
//阴码，顺向，逐行式 C51 十六进制，对应英文点阵 24×32
{

//0(0) 1(1) 2(2) 3(3) 4(4) 5(5) 6(6) 7(7) 8(8) 9(9)

    {
        0x00, 0x00, 0x00, 0x00, 0x00, 0x00, 0x00, 0x00, 0x00, 0x00, 0x00, 0x00, 0x00, 0x7F, 0x80, 0x01,
        0xFF, 0xE0, 0x03, 0xFF, 0xF0, 0x07, 0xC0, 0xF8, 0x0F, 0x80, 0x7C, 0x1F, 0x00, 0x3E, 0x1E, 0x00,
        0x1E, 0x1E, 0x00, 0x1E, 0x3C, 0x00, 0x0F, 0x3C, 0x00, 0x0F, 0x3C, 0x00, 0x0F, 0x3C, 0x00, 0x0F,
        0x3C, 0x00, 0x0F, 0x3C, 0x00, 0x0F, 0x3C, 0x00, 0x0F, 0x1E, 0x00, 0x1E, 0x1E, 0x00, 0x1E, 0x1F,
        0x00, 0x3E, 0x0F, 0x80, 0x7C, 0x07, 0xC0, 0xF8, 0x03, 0xFF, 0xF0, 0x01, 0xFF, 0xE0, 0x00, 0x7F,
        0x80, 0x00, 0x00, 0x00, 0x00, 0x00, 0x00, 0x00, 0x00, 0x00, 0x00, 0x00, 0x00, 0x00, 0x00, 0x00
    },/*"0",0*/

    {
        0x00, 0x00, 0x00, 0x00, 0x00, 0x00, 0x00, 0x00, 0x00, 0x00, 0x00, 0x00, 0x1F, 0xFE, 0x00, 0x1F,
        0xFE, 0x00, 0x1F, 0xFE, 0x00, 0x00, 0x3E, 0x00, 0x00, 0x1E, 0x00, 0x00, 0x1E, 0x00, 0x00, 0x1E,
        0x00, 0x00, 0x1E, 0x00, 0x00, 0x1E, 0x00, 0x00, 0x1E, 0x00, 0x00, 0x1E, 0x00, 0x00, 0x1E, 0x00,
        0x00, 0x1E, 0x00, 0x00, 0x1E, 0x00, 0x00, 0x1E, 0x00, 0x00, 0x1E, 0x00, 0x00, 0x1E, 0x00, 0x00,
        0x1E, 0x00, 0x00, 0x1E, 0x00, 0x00, 0x1E, 0x00, 0x1F, 0xFF, 0xFE, 0x3F, 0xFF, 0xFE, 0x1F, 0xFF,
        0xFE, 0x00, 0x00, 0x00, 0x00, 0x00, 0x00, 0x00, 0x00, 0x00, 0x00, 0x00, 0x00, 0x00, 0x00, 0x00
    },/*"1",1*/

    {
        0x00, 0x00, 0x00, 0x00, 0x00, 0x00, 0x00, 0x00, 0x00, 0x00, 0x00, 0x00, 0x00, 0xFF, 0x80, 0x07,
        0xFF, 0xE0, 0x0F, 0xFF, 0xF8, 0x1F, 0x00, 0xF8, 0x3C, 0x00, 0x7C, 0x3C, 0x00, 0x3C, 0x3C, 0x00,
        0x3C, 0x3C, 0x00, 0x3C, 0x1C, 0x00, 0x3C, 0x00, 0x00, 0x78, 0x00, 0x00, 0xF0, 0x00, 0x01, 0xF0,
        0x00, 0x03, 0xC0, 0x00, 0x0F, 0x80, 0x00, 0x3F, 0x00, 0x00, 0xFC, 0x00, 0x03, 0xF0, 0x0C, 0x0F,
        0xF8, 0x1F, 0x1F, 0xFF, 0x0F, 0x3F, 0xFF, 0x8F, 0x3C, 0x1F, 0xFF, 0x3C, 0x07, 0xFE, 0x3C, 0x01,
        0xFC, 0x00, 0x00, 0x00, 0x00, 0x00, 0x00, 0x00, 0x00, 0x00, 0x00, 0x00, 0x00, 0x00, 0x00, 0x00
    },/*"2",2*/

    {
        0x00, 0x00, 0x00, 0x00, 0x00, 0x00, 0x00, 0x00, 0x00, 0x00, 0x00, 0x00, 0x0F, 0xFF, 0xFF, 0x0F,
        0xFF, 0xFF, 0x0F, 0xFF, 0xFE, 0x0F, 0x00, 0x3E, 0x0F, 0x00, 0x7C, 0x0F, 0x00, 0xF8, 0x06, 0x01,
        0xF0, 0x00, 0x01, 0xE0, 0x00, 0x03, 0xC0, 0x00, 0x07, 0x80, 0x00, 0xFF, 0xF0, 0x00, 0xFF, 0xFC,
        0x00, 0xFF, 0xFE, 0x00, 0x00, 0x7F, 0x00, 0x00, 0x1F, 0x00, 0x00, 0x0F, 0x3C, 0x00, 0x0F, 0x3C,
        0x00, 0x0F, 0x3C, 0x00, 0x1E, 0x1F, 0x00, 0x7E, 0x1F, 0xFF, 0xFC, 0x07, 0xFF, 0xF0, 0x01, 0xFF,
        0x80, 0x00, 0x00, 0x00, 0x00, 0x00, 0x00, 0x00, 0x00, 0x00, 0x00, 0x00, 0x00, 0x00, 0x00, 0x00
    },/*"3",3*/

    {
        0x00, 0x00, 0x00, 0x00, 0x00, 0x00, 0x00, 0x00, 0x00, 0x00, 0x00, 0x00, 0x00, 0x03, 0xE0, 0x00,
        0x07, 0xE0, 0x00, 0x07, 0xE0, 0x00, 0x0F, 0xE0, 0x00, 0x1F, 0xE0, 0x00, 0x3F, 0xE0, 0x00, 0x7D,
        0xE0, 0x00, 0xF9, 0xE0, 0x01, 0xF1, 0xE0, 0x03, 0xE1, 0xE0, 0x07, 0xC1, 0xE0, 0x0F, 0x81, 0xE0,
        0x1F, 0x01, 0xE0, 0x3E, 0x01, 0xE0, 0x7F, 0xFF, 0xFF, 0x7F, 0xFF, 0xFF, 0x3F, 0xFF, 0xFF, 0x00,
        0x01, 0xE0, 0x00, 0x01, 0xE0, 0x00, 0x01, 0xE0, 0x00, 0x7F, 0xFF, 0x00, 0x7F, 0xFF, 0x00, 0x7F,
        0xFF, 0x00, 0x00, 0x00, 0x00, 0x00, 0x00, 0x00, 0x00, 0x00, 0x00, 0x00, 0x00, 0x00, 0x00, 0x00
    },/*"4",4*/

    {
        0x00, 0x00, 0x00, 0x00, 0x00, 0x00, 0x00, 0x00, 0x00, 0x00, 0x00, 0x00, 0x0F, 0xFF, 0xFC, 0x0F,
        0xFF, 0xFC, 0x0F, 0xFF, 0xFC, 0x0F, 0x00, 0x3C, 0x0F, 0x00, 0x3C, 0x0F, 0x00, 0x3C, 0x0F, 0x00,
        0x3C, 0x0F, 0x00, 0x00, 0x0F, 0x00, 0x00, 0x0F, 0x3F, 0xC0, 0x0F, 0xFF, 0xF0, 0x0F, 0xFF, 0xFC,
        0x0F, 0x80, 0x7E, 0x06, 0x00, 0x1F, 0x00, 0x00, 0x0F, 0x00, 0x00, 0x0F, 0x18, 0x00, 0x0F, 0x3C,
        0x00, 0x1F, 0x3C, 0x00, 0x3E, 0x3F, 0x00, 0xFE, 0x1F, 0xFF, 0xFC, 0x07, 0xFF, 0xF0, 0x01, 0xFF,
        0x80, 0x00, 0x00, 0x00, 0x00, 0x00, 0x00, 0x00, 0x00, 0x00, 0x00, 0x00, 0x00, 0x00, 0x00, 0x00
    },/*"5",5*/

    {
        0x00, 0x00, 0x00, 0x00, 0x00, 0x00, 0x00, 0x00, 0x00, 0x00, 0x00, 0x00, 0x00, 0x1F, 0xF0, 0x00,
        0xFF, 0xFC, 0x01, 0xFF, 0xFE, 0x07, 0xF8, 0x1F, 0x07, 0xE0, 0x0F, 0x0F, 0xC0, 0x0E, 0x1F, 0x80,
        0x00, 0x1F, 0x00, 0x00, 0x1F, 0x00, 0x00, 0x3F, 0x3F, 0xC0, 0x3F, 0xFF, 0xF8, 0x3F, 0xFF, 0xFC,
        0x3F, 0x80, 0x7E, 0x3E, 0x00, 0x1F, 0x3C, 0x00, 0x0F, 0x3C, 0x00, 0x0F, 0x3C, 0x00, 0x0F, 0x1E,
        0x00, 0x0F, 0x1F, 0x00, 0x1E, 0x0F, 0xC0, 0x7E, 0x07, 0xFF, 0xFC, 0x03, 0xFF, 0xF8, 0x00, 0x7F,
        0xC0, 0x00, 0x00, 0x00, 0x00, 0x00, 0x00, 0x00, 0x00, 0x00, 0x00, 0x00, 0x00, 0x00, 0x00, 0x00
    },/*"6",6*/

    {
        0x00, 0x00, 0x00, 0x00, 0x00, 0x00, 0x00, 0x00, 0x00, 0x38, 0x00, 0x00, 0x3F, 0xFF, 0x9E, 0x3F,
        0xFF, 0xFF, 0x3F, 0xFF, 0xFE, 0x3C, 0x00, 0xFC, 0x3C, 0x00, 0x7C, 0x3C, 0x00, 0xF8, 0x3C, 0x01,
        0xF0, 0x3C, 0x03, 0xE0, 0x00, 0x03, 0xC0, 0x00, 0x07, 0xC0, 0x00, 0x0F, 0x80, 0x00, 0x0F, 0x00,
        0x00, 0x1E, 0x00, 0x00, 0x3E, 0x00, 0x00, 0x3C, 0x00, 0x00, 0x7C, 0x00, 0x00, 0x7C, 0x00, 0x00,
        0x78, 0x00, 0x00, 0x78, 0x00, 0x00, 0xF8, 0x00, 0x00, 0xF8, 0x00, 0x00, 0xF8, 0x00, 0x00, 0x78,
        0x00, 0x00, 0x00, 0x00, 0x00, 0x00, 0x00, 0x00, 0x00, 0x00, 0x00, 0x00, 0x00, 0x00, 0x00, 0x00
    },/*"7",7*/

    {
        0x00, 0x00, 0x00, 0x00, 0x00, 0x00, 0x00, 0x00, 0x00, 0x00, 0x00, 0x00, 0x00, 0xFF, 0xC0, 0x03,
        0xFF, 0xF0, 0x0F, 0xFF, 0xFC, 0x0F, 0x80, 0x7C, 0x1F, 0x00, 0x3E, 0x1E, 0x00, 0x1E, 0x1E, 0x00,
        0x1E, 0x1E, 0x00, 0x1E, 0x0F, 0x00, 0x3C, 0x0F, 0x80, 0x7C, 0x03, 0xFF, 0xF0, 0x07, 0xFF, 0xF8,
        0x0F, 0xFF, 0xFC, 0x1F, 0x80, 0x7E, 0x3E, 0x00, 0x1F, 0x3C, 0x00, 0x0F, 0x3C, 0x00, 0x0F, 0x3C,
        0x00, 0x0F, 0x3E, 0x00, 0x1F, 0x1F, 0x80, 0x7E, 0x0F, 0xFF, 0xFC, 0x07, 0xFF, 0xF8, 0x00, 0xFF,
        0xC0, 0x00, 0x00, 0x00, 0x00, 0x00, 0x00, 0x00, 0x00, 0x00, 0x00, 0x00, 0x00, 0x00, 0x00, 0x00
    },/*"8",8*/

    {
        0x00, 0x00, 0x00, 0x00, 0x00, 0x00, 0x00, 0x00, 0x00, 0x00, 0x00, 0x00, 0x00, 0xFF, 0x80, 0x03,
        0xFF, 0xF0, 0x07, 0xFF, 0xF8, 0x0F, 0x80, 0xF8, 0x0F, 0x00, 0x7C, 0x1E, 0x00, 0x3C, 0x1E, 0x00,
        0x3E, 0x1E, 0x00, 0x1E, 0x1E, 0x00, 0x1E, 0x1E, 0x00, 0x1E, 0x1F, 0x00, 0x3E, 0x0F, 0x80, 0xFE,
        0x07, 0xFF, 0xFE, 0x03, 0xFF, 0xFE, 0x00, 0x7F, 0x9E, 0x00, 0x00, 0x3C, 0x00, 0x00, 0x3C, 0x1E,
        0x00, 0x7C, 0x1E, 0x00, 0xF8, 0x1F, 0x03, 0xF0, 0x0F, 0xFF, 0xE0, 0x07, 0xFF, 0xC0, 0x01, 0xFE,
        0x00, 0x00, 0x00, 0x00, 0x00, 0x00, 0x00, 0x00, 0x00, 0x00, 0x00, 0x00, 0x00, 0x00, 0x00, 0x00
    },/*"9",9*/

};

//阴码，顺向，逐行式 C51 十六进制，对应英文点阵 24×32,Gungsuh Font
const unsigned char  digitalFont1_24x32[] =
{
//0(0) 1(1) 2(2) 3(3) 4(4) 5(5) 6(6) 7(7) 8(8) 9(9)

    0x00, 0x00, 0x00, 0x00, 0x00, 0x00, 0x00, 0x00, 0x00, 0x00, 0x00, 0x00, 0x00, 0x7F, 0x80, 0x01,
    0xFF, 0xE0, 0x03, 0xFF, 0xF0, 0x07, 0xC0, 0xF8, 0x0F, 0x80, 0x7C, 0x1F, 0x00, 0x3E, 0x1E, 0x00,
    0x1E, 0x1E, 0x00, 0x1E, 0x3C, 0x00, 0x0F, 0x3C, 0x00, 0x0F, 0x3C, 0x00, 0x0F, 0x3C, 0x00, 0x0F,
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    0x00, 0x00, 0x00, 0x00, 0x00, 0x00, 0x00, 0x00, 0x00, 0x00, 0x00, 0x00, 0x00, 0x00, 0x00, 0x00, /*"9",9*/

};
void lcd_init()
{
    LCD_Init();

    BLK_ON;
    LCD_Clear_GDRAM();
    LCD12864_Write_SuperString(0, 0, "启动中");
//    LCD12864_Write_SuperString(1, 0, "2.按键测试");
//    LCD12864_Write_SuperString(2, 0, "3.背光测试");
//    HAL_Delay(800);
//    LCD_Clear_DDRAM();
    LCD_Clear_DDRAM();
	LCD_Clear_GDRAM();

}
const unsigned char SET11_B[] = {
0xFF,0xFB,0xFF,0x7B,0xFE,0xBB,0xFD,0xDF,0xFE,0xFF,0xFF,0xFF,0xEF,0xFF,0xD7,0xFF,
	0xBF,0xFF,0xDF,0xF8,0xEF,0xEF,0xFF,0xDF,0xFF,0xFF,0x1F,0xBF,0xFF,0xBF,0xFF,0xFF};
/*"E:\git\Hardware\flow pump\requirement\16x16\设置2.bmp",0*/




void lcd_proc_test()
{

    {
//        LCD_Baddot_test();
//
//        LCD_Clear_GDRAM();
        LCD12864_Write_SuperString(1, 1, "ST7920 LCD");
        // ShowStringPos(2, 1,"    TEST OK"); HAL_Delay(500);

        //HAL_Delay(500);
        // LCD12864_picture((unsigned char *)SET11_B);
        LCD12864_Fixpicture(1, 4, 1, 2, 16, (unsigned char *)SET11_B);
        HAL_Delay(200);
//        LCD_Clear_GDRAM();
//        LCD12864_Fixpicture(3, 2, 2, 2, 16, (unsigned char *)SET1_B);
//
//        HAL_Delay(500);
//        LCD_Clear_DDRAM();
        //BSP_LED_Toggle(LED2);
    }

}



