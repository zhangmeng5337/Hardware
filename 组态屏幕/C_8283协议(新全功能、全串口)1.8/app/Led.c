/*
                  版权所有 (C), 2020, 北京迪文科技有限公司

 ******************************************************************************
  作    者   : Cui           
  生成日期   : 2022年3月10日
  功能描述   : 
	联系方式   ：18202831680
******************************************************************************/
#include  "Led.h"
u8     Flaga=0;
sbit   WS2812_IO=P0^4; //TX2复用为IO口 
//===================================	
void delay_100ns(unsigned char t)
{	
	char i;
	while(t)
	{	
		for(i=0;i<5;i++)
		{
			i=i;
		}
		t--;
	}
}
//===================================	
void  ws2812_writ_byte(u8 dat)
{
    u8 i=8;
    while(i--)
    {
           WS2812_IO=1;
           delay_100ns(3);
           if((dat&0x80)==0x80)
           {
                   delay_100ns(4);
                   WS2812_IO=0;
                   delay_100ns(8);
           }
           else
            {
                 WS2812_IO=0;
                  delay_100ns(8);
           }
    }
	}
//===================================	

//===================================	