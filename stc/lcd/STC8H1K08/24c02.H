#define bchar bdata unsigned char
#define uchar  unsigned char
#define uint   unsigned int
#define xchar xdata unsigned char
#define xint  xdata unsigned int
#define ulong unsigned long
#define xlong xdata unsigned long
#define DEBUG_EN  0
extern unsigned char busy;
sbit led=P1^3;	//背光
sbit sda=P7^2;
sbit scl=P7^1;	//24C16

sbit d1=P5^4;	//运行
sbit d2=P4^0;	//通信
sbit d3=P6^4;	//消防

bit xf_fig;	//消防控制方式 1：强启 0：强切
bit botelv_fig;//波特率调整 1：9600  0：4800
bit dingshi_fig; //定时设置方式 1：随第一路时间 0：自定义时间

bchar mbdz=0x00;
sbit trd_tt=mbdz^0;	//通信灯标致
sbit xfd_tt=mbdz^1;	//消防灯标致
sbit rlk_bz=mbdz^2;	//
sbit rcg_bz=mbdz^3;	//
sbit dnyr_t=mbdz^4;	//
sbit rlrc_p=mbdz^5;	//
sbit sc_bz =mbdz^6;	//
sbit cf_bz =mbdz^7;	//

bchar jwsq=0x00;
sbit jx_tt=jwsq^0;	//0 东经,  1 西经
sbit wx_tt=jwsq^1;	//0 北纬,  1 南纬
sbit sq_tt=jwsq^2;	//0 东时区,1 西时区
sbit gm_tt=jwsq^3;	//0 未接   1 连接
sbit ss_tt=jwsq^4;	//闪烁标志
sbit cs_tt=jwsq^5;	//参数标志
sbit rx_tt=jwsq^6;	//接收标志
sbit tx_tt=jwsq^7;	//发送标志

bchar xqbz=0x00;			//星期标志
sbit xq_ta=xqbz^0;	//1
sbit xq_tb=xqbz^1;	//2
sbit xq_tc=xqbz^2;	//3
sbit xq_td=xqbz^3;	//4
sbit xq_te=xqbz^4;	//5
sbit xq_tf=xqbz^5;	//6
sbit xq_tg=xqbz^6;	//7
sbit xq_th=xqbz^7;	//8 */

bchar rlka=0x00;		//01-08自动日落标志
sbit rl_la=rlka^0;	//1
sbit rl_lb=rlka^1;	//2
sbit rl_lc=rlka^2;	//3
sbit rl_ld=rlka^3;	//4
sbit rl_le=rlka^4;	//5
sbit rl_lf=rlka^5;	//6
sbit rl_lg=rlka^6;	//7
sbit rl_lh=rlka^7;	//8

bchar rlkb=0x00;		//09-16自动日落标志
sbit rl_ha=rlkb^0;	//1
sbit rl_hb=rlkb^1;	//2
sbit rl_hc=rlkb^2;	//3
sbit rl_hd=rlkb^3;	//4
sbit rl_he=rlkb^4;	//5
sbit rl_hf=rlkb^5;	//6
sbit rl_hg=rlkb^6;	//7
sbit rl_hh=rlkb^7;	//8

bchar rcga=0x00;		//01-08自动日出标志
sbit rc_la=rcga^7;	//1
sbit rc_lb=rcga^6;	//2
sbit rc_lc=rcga^5;	//3
sbit rc_ld=rcga^4;	//4
sbit rc_le=rcga^3;	//5
sbit rc_lf=rcga^2;	//6
sbit rc_lg=rcga^1;	//7
sbit rc_lh=rcga^0;	//8

bchar rcgb=0x00;		//09-16自动日出标志
sbit rc_ha=rcgb^7;	//1
sbit rc_hb=rcgb^6;	//2
sbit rc_hc=rcgb^5;	//3
sbit rc_hd=rcgb^4;	//4
sbit rc_he=rcgb^3;	//5
sbit rc_hf=rcgb^2;	//6
sbit rc_hg=rcgb^1;	//7
sbit rc_hh=rcgb^0;	//8

bchar yzbl=0x00;			//
sbit scha=yzbl^7;	//1
sbit schb=yzbl^6;	//2
sbit schc=yzbl^5;	//3
sbit schd=yzbl^4;	//4
sbit sche=yzbl^3;	//5
sbit schf=yzbl^2;	//6
sbit schg=yzbl^1;	//7
sbit schh=yzbl^0;	//8

bchar jsll=0x00;			//
sbit scla=jsll^7;	//1
sbit sclb=jsll^6;	//2
sbit sclc=jsll^5;	//3
sbit scld=jsll^4;	//4
sbit scle=jsll^3;	//5
sbit sclf=jsll^2;	//6
sbit sclg=jsll^1;	//7
sbit sclh=jsll^0;	//8

bchar yzblb=0x00;			//
sbit bcha=yzblb^7;	//1
sbit bchb=yzblb^6;	//2
sbit bchc=yzblb^5;	//3
sbit bchd=yzblb^4;	//4
sbit bche=yzblb^3;	//5
sbit bchf=yzblb^2;	//6
sbit bchg=yzblb^1;	//7
sbit bchh=yzblb^0;	//8

bchar jsllb=0x00;			//
sbit bcla=jsllb^7;	//1
sbit bclb=jsllb^6;	//2
sbit bclc=jsllb^5;	//3
sbit bcld=jsllb^4;	//4
sbit bcle=jsllb^3;	//5
sbit bclf=jsllb^2;	//6
sbit bclg=jsllb^1;	//7
sbit bclh=jsllb^0;	//8


bchar dskh=0x00;			//
sbit dshka=dskh^7;	//1
sbit dshkb=dskh^6;	//2
sbit dshkc=dskh^5;	//3
sbit dshkd=dskh^4;	//4
sbit dshke=dskh^3;	//5
sbit dshkf=dskh^2;	//6
sbit dshkg=dskh^1;	//7
sbit dshkh=dskh^0;	//8

bchar dskl=0x00;			//
sbit dslka=dskl^7;	//1
sbit dslkb=dskl^6;	//2
sbit dslkc=dskl^5;	//3
sbit dslkd=dskl^4;	//4
sbit dslke=dskl^3;	//5
sbit dslkf=dskl^2;	//6
sbit dslkg=dskl^1;	//7
sbit dslkh=dskl^0;	//8

uchar dsgh;			//
uchar dsgl;			//


uchar key,k;
uchar key_time=100;//设置参数时 长时间不操作自动退出设置
uchar xhao;		//1,4路   2,8路   3,12路  4,16路
uchar cans=0,yiwei=0;
xint mima=0;
uchar led_beiguang=0; //显示屏背光时间 长时间无按键动作自动关闭背光
xint shifk=0,shifg=0;	//
xint rlsfk=0,rcsfg=0;
xint xzsfm=0;

xchar tpi=0,wsms=0,xian=0,dssd=0;
uchar dsls=0;
xchar rics=0,ricf=0;
xchar rils=0,rilf=0;

xint shic=0,shil=0;

xchar nian,yue,ri,zhou,shi,fen,miao;
xchar jingd,jingf;	//经度
xchar weidd,weidf;	//纬度
xchar shiqz,shiqf;	//时区

xint ipdz;

xchar kgls=1;			//开关路数01-16
xchar shid=1;			//时段1-4
unsigned char kshia=0,kfena=0,gshia=0,gfena=0;//第1时段
unsigned char kshib=0,kfenb=0,gshib=0,gfenb=0;//第2时段
unsigned char kshic=0,kfenc=0,gshic=0,gfenc=0;//第3时段
unsigned char kshid=0,kfend=0,gshid=0,gfend=0;//第4时段

xchar gzdu;
xchar cxcs=0,txcx,xsqh,txbz,sdfw,cfjs;

uchar   rp[8];
uchar   tp[8];
xchar  jwsp[16];
xchar  jiar[16];	//星期
xchar  gmkg[32];
xchar  dsf[256];
uchar code sp[]=
{
    0x00,		//经纬标志
    0x78,0x31,	//经度120 49
    0x1c,0x12,	//经度 28 18
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    0x01,				//波特率 1：9600
    0x00				//定时不随第一路
};



uchar code shuz[]=
{
    0x00,0xE0,0x10,0x08,0x08,0x10,0xE0,0x00,0x00,0x0F,0x10,0x20,0x20,0x10,0x0F,0x00,//0
    0x00,0x10,0x10,0xF8,0x00,0x00,0x00,0x00,0x00,0x20,0x20,0x3F,0x20,0x20,0x00,0x00,//1
    0x00,0x70,0x08,0x08,0x08,0x88,0x70,0x00,0x00,0x30,0x28,0x24,0x22,0x21,0x30,0x00,//2
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    0x00,0xE0,0x10,0x08,0x08,0x10,0xE0,0x00,0x00,0x00,0x31,0x22,0x22,0x11,0x0F,0x00,//9
};

uchar code zhif[]=
{
    0x00,0x00,0x80,0x80,0x80,0x80,0x00,0x00,0x00,0x19,0x24,0x22,0x22,0x22,0x3F,0x20,//a 0
    0x08,0xF8,0x00,0x80,0x80,0x00,0x00,0x00,0x00,0x3F,0x11,0x20,0x20,0x11,0x0E,0x00,//b 1
    0x00,0x00,0x00,0x80,0x80,0x80,0x00,0x00,0x00,0x0E,0x11,0x20,0x20,0x20,0x11,0x00,//c 2
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    0xE0,0x10,0x08,0x08,0x08,0x10,0xE0,0x00,0x0F,0x10,0x20,0x20,0x20,0x10,0x0F,0x00,//O40
	//0x00,0x00,0x38,0x6C,0xC6,0xC6,0xC6,0xC6,0xC6,0xC6,0x6C,0x38,0x00,0x00,0x00,0x00, // -O
	0x08,0xF8,0x08,0x08,0x08,0x08,0xF0,0x00,0x20,0x3F,0x21,0x01,0x01,0x01,0x00,0x00,//P41
    0xE0,0x10,0x08,0x08,0x08,0x10,0xE0,0x00,0x0F,0x18,0x24,0x24,0x38,0x50,0x4F,0x00,//Q42
    0x08,0xF8,0x88,0x88,0x88,0x88,0x70,0x00,0x20,0x3F,0x20,0x00,0x03,0x0C,0x30,0x20,//R43
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    0x00,0x00,0x00,0xC0,0xC0,0x00,0x00,0x00,0x00,0x00,0x00,0x30,0x30,0x00,0x00,0x00,//: //52
   // 0x00,0x00,0x02,0x08,0x02,0x08,0x00,0x00,0x00,0x00,0x00,0x00,0x00,0x00,0x00,0x00,
    0x00,0x00,0x00,0x00,0x00,0x00,0x00,0x00,0x00,0x01,0x01,0x01,0x01,0x01,0x01,0x01,//-53
    0x00,0x00,0x00,0x00,0x00,0x00,0x00,0x00,0x00,0x00,0x00,0x00,0x00,0x00,0x00,0x00,//54
    0x00,0x20,0x50,0x20,0x00,0x00,0x00,0x00,0x00,0x00,0x00,0x00,0x00,0x00,0x00,0x00,//`55
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	0x00,0x00,0x00,0x00,0x00,0x00,0x00,0x00,0x00,0x18,0x18,0x18,0x30,0x00,0x00,0x00,//61

};

uchar code hanzi[]=
{
    0x00,0x00,0x20,0x10,0xCE,0x44,0x44,0x44,0xFC,0x44,0x44,0x44,0x44,0x04,0x00,0x00,
    0x00,0x04,0x04,0x04,0x07,0x04,0x04,0x04,0x7F,0x04,0x04,0x04,0x04,0x04,0x04,0x00,//年0
    0x00,0x00,0x00,0x00,0x00,0x00,0x00,0x00,0x00,0x00,0x00,0x00,0x00,0x80,0x00,0x00,
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    0x00,0x80,0x80,0x40,0x20,0x11,0x0A,0x04,0x0A,0x11,0x10,0x20,0x60,0xC0,0x40,0x00,//义65
};
uchar code deng[]=
{
    0x00,0x00,0x20,0x40,0x84,0x08,0x10,0x20,0x42,0x84,0x88,0x50,0x42,0x44,0x28,0x20,
    0x20,0x28,0x44,0x42,0x50,0x88,0x84,0x02,0x20,0x10,0x08,0x84,0x42,0x20,0x00,0x00,
    0x00,0x09,0x12,0x24,0x48,0x81,0x0C,0x32,0x41,0x80,0x00,0x00,0x00,0x00,0x08,0x04,
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    0x20,0x3F,0x00,0x00,0x00,0x00,0x00,0x00,0x00,0x00,0x00,0x00,0x00,0x00,0x00,0x00,
};

//延时程序
void delay(uchar i)
{
    while(i!=0)
    {
        i--;
    }
}
void delaya(uchar x)
{
    uchar y,z;
    for(y=x; y>0; y--)
        for(z=180; z>0; z--);
}
//串口字节发送
void com_data_tx(unsigned char data2)
{


    //EA=0;
    SBUF=data2;
    while(TI==0) {;};
    TI=0;
    //EA=1;

}//*/
/********************************************eeprom*****************************/

unsigned char sectors_cal(int addr)
{
    unsigned char sectors_num;
    if(addr>=0&&addr<512)
    {
        sectors_num = 0;
    }
    else if(addr>=512&&addr<1024)
    {
        sectors_num = 1;
    }
    else if(addr>=1024&&addr<1536)
    {
        sectors_num = 2;
    }
    else if(addr>=1536&&addr<2048)
    {
        sectors_num = 3;
    }
    else if(addr>=2048&&addr<2560)
    {
        sectors_num = 4;
    }
    else if(addr>=2560&&addr<3072)
    {
        sectors_num = 5;
    }
    else if(addr>=3072&&addr<3584)
    {
        sectors_num = 6;
    }
    else if(addr>=3584&&addr<4096)
    {
        sectors_num = 7;
    }
    return sectors_num;
}
void IapIdle()
{
    IAP_CONTR = 0;                              //关闭IAP功能
    IAP_CMD = 0;                                //清除命令寄存器
    IAP_TRIG = 0;                               //清除触发寄存器
    IAP_ADDRH = 0x80;                           //将地址设置到非IAP区域
    IAP_ADDRL = 0;
}
int sector_cal(int add)
{
    int tmp;
    if(add>=0&&add<1)
    {
        tmp = 0;
    }
    else if(add>=1&&add<2)
    {
        tmp = 512;
    }
    else if(add>=2&&add<3)
    {
        tmp = 1024;
    }
    else if(add>=3&&add<4)
    {
        tmp = 1536;
    }
    else if(add>=4&&add<5)
    {
        tmp = 2048;
    }
    else if(add>=5&&add<6)
    {
        tmp = 2560;
    }
    else if(add>=6&&add<7)
    {
        tmp = 3072;
    }
    else if(add>=7&&add<8)
    {
        tmp = 3584;
    }
    return tmp;

}

char IapRead(int addr)
{
    char dat;

    IAP_CONTR = 0x80;                           //使能IAP
    IAP_TPS = 12;                               //设置等待参数12MHz
    IAP_CMD = 1;                                //设置IAP读命令
    IAP_ADDRL = addr;                           //设置IAP低地址
    IAP_ADDRH = addr >> 8;                      //设置IAP高地址
    IAP_TRIG = 0x5a;                            //写触发命令(0x5a)
    IAP_TRIG = 0xa5;                            //写触发命令(0xa5)
    _nop_();
    _nop_();
    _nop_();
    _nop_();
    _nop_();
    dat = IAP_DATA;                             //读IAP数据
    IapIdle();                                  //关闭IAP功能

    return dat;
}

void IapProgram(int addr, char dat)
{
    IAP_CONTR = 0x80;                           //使能IAP
    IAP_TPS = 12;                               //设置等待参数12MHz
    IAP_CMD = 2;                                //设置IAP写命令
    IAP_ADDRL = addr;                           //设置IAP低地址
    IAP_ADDRH = addr >> 8;                      //设置IAP高地址
    IAP_DATA = dat;                             //写IAP数据
    IAP_TRIG = 0x5a;                            //写触发命令(0x5a)
    IAP_TRIG = 0xa5;                            //写触发命令(0xa5)
    _nop_();
    _nop_();
    _nop_();
    _nop_();
    _nop_();
    IapIdle();                                  //关闭IAP功能
}

void IapErase(int add,int addr)
{
    int add_tmp;
    add_tmp = sector_cal( add) ;
    EA=0;
    IAP_CONTR = 0x80;                           //使能IAP
    IAP_TPS = 12;                               //设置等待参数12MHz
    IAP_CMD = 3;                                //设置IAP擦除命令
    IAP_ADDRL = add_tmp;                           //设置IAP低地址
    IAP_ADDRH = add_tmp >> 8;                      //设置IAP高地址
    IAP_TRIG = 0x5a;                            //写触发命令(0x5a)
    IAP_TRIG = 0xa5;                            //写触发命令(0xa5)
    _nop_();
    _nop_();
    _nop_();
    _nop_();
    _nop_();  //
    IapIdle();                                  //关闭IAP功能
    EA=1;
}

//24C02起始信号
void start()
{
    sda=1;
    delay(5);
    scl=1;
    delay(10);
    sda=0;
    delay(10);
    scl=0;
    delay(5);
}
//24C02终止信号
void stop()
{
    scl=0;
    delay(10);
    sda=0;
    delay(10);
    scl=1;
    delay(10);
    sda=1;
    delay(10);
}
//24C02应答信号
void respons()
{
    uchar i=255;
    sda=1;
    delay(10);
    scl=1;
    delay(10);
    while(sda)
    {
        i--;
        delay(5);
        if(i==0)sda=0;
    }
    scl=0;
    delay(10);
}
//向24C02写入一个字节
void write_byte(uchar date)
{
    uchar i,temp;
    temp=date;
    for(i=0; i<8; i++)
    {
        temp=temp<<1;
        scl=0;
        delay(10);
        sda=CY;
        delay(10);
        scl=1;
        delay(5);
    }
    scl=0;
    delay(10);
    sda=1;
    delay(10);
}
//向24C02读出一个字节
uchar read_byte()
{
    uchar i,k;
    scl=0;
    delay(10);
    sda=1;
    delay(10);
    for(i=0; i<8; i++)
    {
        scl=1;
        delay(10);
        k=(k<<1)|sda;
        delay(5);
        scl=0;
        delay(10);
    }
    return k;
}

//在24c02指定地址读出数据
uchar read_add(int add,uchar address)
{
    uchar date;
    int addr,sector_addr;
    sector_addr = sector_cal( add) ;
    addr = sector_addr+address;
//	start();
//	write_byte(0xa0+(add<<1));
//	respons();
//	write_byte(address);
//	respons();
//	start();
//	write_byte(0xa1+(add<<1));
//	respons();
//	date=read_byte();
//	stop();


    EA=0;
    date = IapRead(addr);
    EA=1;
    return date;
}

//在24c02指定地址写入数据
static  xchar buf[256];
void read_ee_data(uchar add,uchar address)
{
    int sector_addr,i;
    int addr;


    sector_addr = sector_cal( add) ; ;
    addr = sector_addr ;
    EA=0;
    for(i=0; i<256; i++)
    {
        buf[i]=read_add(add,addr+i);

    }
    EA=1;

}
void write_add(uchar add,uchar address,uchar date)
{
    int sector_addr,i;
    int addr;
    sector_addr = sector_cal( add) ;
    addr = sector_addr ;
    /*  for(i=0; i<512; i++)
      {
          buf[i]=read_add(addr+i);

      }*/
    EA=0;
    for(i=0; i<256; i++)
    {
        // if(i!=address)
        IapProgram(addr+i, buf[i]);
        // else
        //   IapProgram(addr+i, date);
    }
    EA=1;



    //IapProgram(addr, date);



}





//2字节转为INT并返回
uint tchr_int(uchar ch1,ch2)
{
    uint ch;
    ch=ch1;
    ch=(ch<<8)|ch2;
    return(ch);
}
//初始化
void init()
{
    uint j;
    P1M1=0x00;
    P1M0=0x00;
    P0M0=0x00;
    P0M1=0x00;
    P2M0=0x00;
    P2M1=0x00;
    P3M0=0x00;
    P3M1=0x00;
    P4M0=0x00;
    P4M1=0x00;
    P5M0=0x00;
    P5M1=0x00;
    P6M0=0x00;
    P6M1=0x00;
    P7M0=0x00;
    P7M1=0x00;
    P3M1 = 0xa0;
    P3M0 = 0x20; //设置为准双向口
// P3.5 设置开漏模式, P3.7 设置高阻输入
    SCON=0x50;		//串口1方式1
    AUXR |=0x01;	//串口1选择定时器2为波特率发生器
    AUXR |=0x04;	//定时器2时钟为Fosc,即1T
    T2L   =0xFD;	//设定定时初值921600
    T2H   =0xFF;	//设定定时初值
    AUXR |=0x10;	//启动定时器2

    ES=1;			//串口1中断
    //PS=1;			//串口1优先
    PS=1;			//串口1优先

    TH0=0x3c;
    TL0=0xb0;
    TR0=1;
    ET0=1;
    led=1;

    xhao=read_add(7,13);
    delaya(50);
#if DEBUG_EN
    com_data_tx(0x5a);
    com_data_tx(xhao);
#endif
    if(xhao>0x04|xhao==0)
    {
        read_ee_data(7,0);
        IapErase(7,0);
        for(j=0; j<18; j++)
        {
            buf[j] = sp[j];
#if DEBUG_EN == 1
            com_data_tx(sp[j]);
#endif
            // delaya(50);
        }
        write_add(7,0,sp[j]);
        delaya(50);
    }
    //com_data_tx('\r');
#if DEBUG_EN == 1
    com_data_tx(0xa5);
#endif
    for(j=0; j<18; j++)
    {

        jwsp[j]=read_add(7,j);
#if DEBUG_EN == 1

        com_data_tx(jwsp[j]);
#endif

        delaya(50);
    }
//	com_data_tx(0x77);
//    for(j=0; j<256; j++)
//    {
//        com_data_tx(jwsp[j]);
//    }	
    jwsq=jwsp[0];
    jingd=jwsp[1];
    jingf=jwsp[2];
    weidd=jwsp[3];
    weidf=jwsp[4];
    shiqz=jwsp[5];
    shiqf=jwsp[6];
    ipdz=tchr_int(jwsp[7],jwsp[8]);
    rlka=jwsp[9];
    rlkb=jwsp[10];
    rcga=jwsp[11];
    rcgb=jwsp[12];
    xhao=jwsp[13];
    xf_fig=jwsp[15];	//消防控制方式 1：强启 0：强切
    botelv_fig=jwsp[16];//波特率调整 1：9600  0：4800
    dingshi_fig=jwsp[17];; //定时设置方式 1：随第一路时间 0：自定义时间

    jiar[0]=read_add(2,0);
    delaya(50);
    if(jiar[0]==0xff)
    {
        read_ee_data(2,0);
        IapErase(2,0);
        for(j=0; j<16; j++)
        {

            buf[j] =0x7f;
        }
        write_add(2,0,0x7f);
        delaya(50);
    }
#if DEBUG_EN == 1
    com_data_tx(0x5b);
#endif
    for(j=0; j<16; j++)
    {
        jiar[j]=read_add(2,j);
#if DEBUG_EN == 1
        com_data_tx( jiar[j]);
#endif
        delaya(50);
    }
    gmkg[1]=read_add(1,1);
    if(gmkg[1]>45)
    {
        read_ee_data(1,0);
        IapErase(1,0);
        for(j=0; j<32; j++)
        {
            if(j&0x01)
                buf[j] = 0x0F;
            else
                buf[j] = 0x08;
        }
        write_add(1,0,0x08);
        delaya(50);
    }
    //com_data_tx('\n');
    //com_data_tx(0x5c);
    for(j=0; j<32; j++)
    {
        gmkg[j]=read_add(1,j);
       // com_data_tx( gmkg[j]);
        delaya(50);
    }
    dsf[0]=read_add(0,0);
    if(dsf[0]>0x23)
    {
        read_ee_data(0,0);
        IapErase(0,0);
        for(j=0; j<256; j++)
        {
            buf[j] = 0x00;

            // delaya(50);
        }
        write_add(0,0,0x00);
        delaya(50);
    }
    //com_data_tx('\n');
//	com_data_tx(0x5d);
    for(j=0; j<256; j++)
    {
        dsf[j]=read_add(0,j);
	//	com_data_tx( dsf[j]);
        delaya(50);
    }
    xian=0;
}
void time1_init(void)
{
    AUXR &= 0xBF;		//定时器时钟12T模式
    TMOD &= 0x0F;		//设置定时器模式
    TL1 = 0x18;			//设置定时初值
    TH1 = 0xFc;			//设置定时初值
    TF1 = 0;			//清除TF1标志
    TR1 = 1;			//定时器1开始计时
    ET1	=1;
}


//串口字节发送
void com_data(void)
{
    uchar i,crc;
    crc=0;
    for(i=0; i<9; i++)crc=crc+tp[i];
    tp[9]=crc;
    //EA=0;
    for(i=0; i<10; i++)
    {
        SBUF=tp[i];
        while(TI==0) {;};
        TI=0;
    }
    //EA=1;
}//*/

void chax_com(void)
{
    tp[0]=0xf5;
    tp[1]=0x01;
    tp[2]=cxcs;
    tp[3]=gmkg[cxcs*4+0];
    tp[4]=gmkg[cxcs*4+1];
    tp[5]=gmkg[cxcs*4+2];
    tp[6]=gmkg[cxcs*4+3];
    tp[7]=xf_fig;
    tp[8]=botelv_fig;
    cxcs++;
    if(cxcs>9)cxcs=0;
    com_data();
}

void kzhi_com(void)
{
    txcx=0;
    tp[0]=0xf5;
    tp[1]=0x02;
    tp[2]=0x00;
    tp[3]=ipdz;
    tp[4]=yzbl;
    tp[5]=jsll;
    tp[6]=0x55;
    tp[7]=xf_fig;
    tp[8]=botelv_fig;
    yzblb=yzbl;
    jsllb=jsll;
    com_data();
}

void bany_deng()
{
    if(rl_la)		//1路
    {
        dsf[0x00]=rils;
        dsf[0x01]=rilf;
    }
    if(rc_la)
    {
        dsf[0x02]=rics;
        dsf[0x03]=ricf;
    }
    if(rl_lb)		//2路
    {
        dsf[0x10]=rils;
        dsf[0x11]=rilf;
    }
    if(rc_lb)
    {
        dsf[0x12]=rics;
        dsf[0x13]=ricf;
    }
    if(rl_lc)		//3路
    {
        dsf[0x20]=rils;
        dsf[0x21]=rilf;
    }
    if(rc_lc)
    {
        dsf[0x22]=rics;
        dsf[0x23]=ricf;
    }
    if(rl_ld)		//4路
    {
        dsf[0x30]=rils;
        dsf[0x31]=rilf;
    }
    if(rc_ld)
    {
        dsf[0x32]=rics;
        dsf[0x33]=ricf;
    }
    if(rl_le)		//5路
    {
        dsf[0x40]=rils;
        dsf[0x41]=rilf;
    }
    if(rc_le)
    {
        dsf[0x42]=rics;
        dsf[0x43]=ricf;
    }
    if(rl_lf)		//6路
    {
        dsf[0x50]=rils;
        dsf[0x51]=rilf;
    }
    if(rc_lf)
    {
        dsf[0x52]=rics;
        dsf[0x53]=ricf;
    }
    if(rl_lg)		//7路
    {
        dsf[0x60]=rils;
        dsf[0x61]=rilf;
    }
    if(rc_lg)
    {
        dsf[0x62]=rics;
        dsf[0x63]=ricf;
    }
    if(rl_lh)		//8路
    {
        dsf[0x70]=rils;
        dsf[0x71]=rilf;
    }
    if(rc_lh)
    {
        dsf[0x72]=rics;
        dsf[0x73]=ricf;
    }
    if(rl_ha)		//9路
    {
        dsf[0x80]=rils;
        dsf[0x81]=rilf;
    }
    if(rc_ha)
    {
        dsf[0x82]=rics;
        dsf[0x83]=ricf;
    }
    if(rl_hb)		//10路
    {
        dsf[0x90]=rils;
        dsf[0x91]=rilf;
    }
    if(rc_hb)
    {
        dsf[0x92]=rics;
        dsf[0x93]=ricf;
    }
    if(rl_hc)		//11路
    {
        dsf[0xa0]=rils;
        dsf[0xa1]=rilf;
    }
    if(rc_hc)
    {
        dsf[0xa2]=rics;
        dsf[0xa3]=ricf;
    }
    if(rl_hd)		//12路
    {
        dsf[0xb0]=rils;
        dsf[0xb1]=rilf;
    }
    if(rc_hd)
    {
        dsf[0xb2]=rics;
        dsf[0xb3]=ricf;
    }
    if(rl_he)		//13路
    {
        dsf[0xc0]=rils;
        dsf[0xc1]=rilf;
    }
    if(rc_he)
    {
        dsf[0xc2]=rics;
        dsf[0xc3]=ricf;
    }
    if(rl_hf)		//14路
    {
        dsf[0xd0]=rils;
        dsf[0xd1]=rilf;
    }
    if(rc_hf)
    {
        dsf[0xd2]=rics;
        dsf[0xd3]=ricf;
    }
    if(rl_hg)		//15路
    {
        dsf[0xe0]=rils;
        dsf[0xe1]=rilf;
    }
    if(rc_hg)
    {
        dsf[0xe2]=rics;
        dsf[0xe3]=ricf;
    }
    if(rl_hh)		//16路
    {
        dsf[0xf0]=rils;
        dsf[0xf1]=rilf;
    }
    if(rc_hh)
    {
        dsf[0xf2]=rics;
        dsf[0xf3]=ricf;
    }
}
